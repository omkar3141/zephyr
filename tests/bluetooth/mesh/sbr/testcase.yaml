## tests/bluetooth/mesh/sbr/testcase.yaml
```yaml
tests:
  bluetooth.mesh.sbr:
    platform_allow:
      - native_posix
      - native_sim
    tags:
      - bluetooth
      - mesh
    integration_platforms:
      - native_sim
```
